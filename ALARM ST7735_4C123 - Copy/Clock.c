//this file is the function calls for both the digital and analog clock
//This function takes no inputs but runs off of Systic Timer Interrupts
//Should have the highest priority so that the clock is constantly being updated
#include <stdio.h>
#include <stdint.h>
#include "ST7735.h"
#include "PLL.h"
#include "LCD.h"
#include "inc/tm4c123gh6pm.h"
#include "switch.h"
#include "PWM.h"

#define PF4   (*((volatile uint32_t *)0x40025040))
extern int hour;
extern int minute;
extern int hour_alarm;
extern int minute_alarm;
extern int sClock;
extern int alarm;

const unsigned short CLOCK[] = {
 0x0000, 0x0000, 0x0000, 0x0000, 0x0000, 0x0000, 0x0000, 0x0000, 0x0000, 0x0000, 0x0000, 0x0000, 0x0000, 0x0000, 0x0000, 0x0000,
 0x0000, 0x0000, 0x0000, 0x0000, 0x0000, 0x0000, 0x0000, 0x0000, 0x0000, 0x0000, 0x0000, 0x0000, 0x0000, 0x0000, 0x0000, 0x0000,
 0x0000, 0x0000, 0x0000, 0x0000, 0x0000, 0x0000, 0x0000, 0x0000, 0xFFFF, 0xFFFF, 0xFFFF, 0xFFFF, 0xFFFF, 0xFFFF, 0xFFFF, 0xFFFF,
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 0x0000, 0x0000, 0x0000, 0x0000, 0x0000, 0x0000, 0x0000, 0x0000, 0x0000,
};



void DisplayClockAnalog(){
	//ST7735_FillScreen(0x0000);            // set screen to black
	ST7735_InitR(INITR_REDTAB);
	ST7735_DrawBitmap(14, 120, CLOCK, 93, 93); //display in the semi-center of the screen
	while(1){
	if (PF4 == 0){
	  ST7735_InitR(INITR_REDTAB);
		printf("CLOCK\nMAIN MENU\n\n\n\n\nPress 1 :SET TIME\nPress 2 :SET ALARM\nPress 3:ALRM ON/OFF\nPress 4 :DISPLAY CLK");
		switchReset();
		break;
	}
	else{
		displayAnalog(hour,minute);
		if(alarm == 1){										//will enter this if alarm is on
			if(hour == hour_alarm){					//checks to make sure hours are equal
				if(minute == minute_alarm){		//checks to make sure minutes are equal
					while(PF4 != 0){
						displayAlarm(hour, minute, 0);
					  PWM0A_Init(40000, 30000);         // initialize PWM0, 1000 Hz, 75% duty
						PWM0B_Init(40000, 10000);         // initialize PWM0, 1000 Hz, 25% duty
					}
					PWM0A_Init(0, 0);         // initialize PWM0, 1000 Hz, 75% duty
					PWM0B_Init(0, 0);
				}
			}
		
		}
	}
}
}
void DisplayClockDigital(){
	ST7735_FillScreen(0x0000);            // set screen to black
	while(1){
if (PF4==0){
	  ST7735_InitR(INITR_REDTAB);
		printf("CLOCK\nMAIN MENU\n\n\n\n\nPress 1 :SET TIME\nPress 2 :SET ALARM\nPress 3:ALRM ON/OFF\nPress 4 :DISPLAY CLK");
		switchReset();
		break;
	}
	else{
			if(minute >= 10){
	printf("%u:%u",hour,minute);
								ST7735_SetCursor(0,0);
	}
	if(minute < 10){
		printf("%u:0%u",hour,minute);
						ST7735_SetCursor(0,0);
	}
	}
}
}
